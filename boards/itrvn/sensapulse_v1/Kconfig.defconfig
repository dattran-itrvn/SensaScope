## boards/itrvn/sensapulse_v1/Kconfig.defconfig
```kconfig
# SPDX-License-Identifier: Apache-2.0

if BOARD_SENSAPULSE_V1

config BT_CTLR
	default BT

endif # BOARD_SENSAPULSE_V1
```

## boards/itrvn/sensapulse_v1/Kconfig.sensapulse_v1
```kconfig
# SPDX-License-Identifier: Apache-2.0

config BOARD_SENSAPULSE_V1
	select SOC_NRF52840_QIAA
```
